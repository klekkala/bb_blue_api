/* Author: Kiran Kumar Lekkala
*/

/dts-v1/;
/plugin/; 

/ {
    compatible = "ti,beaglebone-black";

    /* identification */
    part-number = "BBB_BUTLED";

    /* version */
    version = "00A0";
	
	exclusive-use =
		"P8.7",		/*LED_RED*/
		"P8.8",		/*LED_GRN*/
		"P8.9",		/*PAUSE_BTN*/
		"P8.10",	/*MODE_BTN*/
		"P8.14",	/*BATT_LED_4*/
		"P8.17",	/*BATT_LED_1*/
		"P8.26",	/*BATT_LED_3*/
		"P8.34",	/*MDIR_2B*/
		"P8.43",	/*MDIR_3B*/
		"P8.44",	/*MDIR_3A*/
		"P8.45",	/*MDIR_4A*/
		"P8.46",	/*MDIR_4B*/
		"P9.12",	/*MDIR_1A*/
		"P9.13",	/*MDIR_1B*/	
		"P9.15",	/*MDIR_2A*/
		"P9.41",	/*MOT_STBY*/
		"P8.36",	/*SERVO_PWR*/
		"P9.23", 	/*SPI1_SS2*/
		"P9.28";	/*SPI1_SS1*/

fragment@0 {
	target = <&am33xx_pinmux>;
	__overlay__ {
		/****************************************
		* 			pinmux helper				
		****************************************/
		mux_helper_pins: pins {
			pinctrl-single,pins = <

			/* GPIO Inputs */
			0x09c 0x37	/*P8.9  Pause BUTTON, input pullup*/
			0x098 0x37	/*P8.10 MODE BUTTON input pullup*/
			0x1AC 0x37	/*P9.25 MPU-9150 INTERRUPT IN*/
			
			/* GPIO Outputs
			0x090 0x0F	/*P8.7, MODE7*/
			0x094 0x0F	/*P8.8*/
			0x028 0x0F	/*P8.14*/
			0x02C 0x0F	/*P8.17*/
			0x08c 0x0F	/*P8.18*/
			0x07c 0x0F	/*P8.26*/
			0x0cc 0x0F	/*P8.34*/
			0x0C8 0x0F	/*P8.36*/
			0x0a8 0x0F	/*P8.43*/
			0x0ac 0x0F	/*P8.44*/
			0x0a0 0x0F	/*P8.45*/
			0x0a4 0x0F	/*P8.46*/
			0x078 0x0F	/*P9.12*/
			0x074 0x0F	/*P9.13*/
			0x040 0x0F	/*P9.15*/
			0x044 0x0F	/*P9.23*/
			0x19C 0x0F	/*P9.28*/
			0x1b4 0x0F	/*P9.41*/

			>;
		};
	};
};

/****************************************
	Pinmux Helper
	activates the pinmux helper list of pin modes
****************************************/
fragment@1 {
	target = <&ocp>;
		__overlay__ {
			test_helper: helper {
			compatible = "bone-pinmux-helper";
			pinctrl-names = "default";
			pinctrl-0 = <&mux_helper_pins>;
			status = "okay";
		};
	};
};