/*
 * Custom overlay for eQEP for Beaglebone Blue
 * Author: Kiran Kumar Lekkala
 */

/dts-v1/;
/plugin/; 

/ {
	compatible = "ti,beaglebone-black";

	// identification
	part-number = "EQEP0";
	version	    = "00A0";

	// resources this cape uses
	exclusive-use =
		/* EQEP */

			"P8.11",	/*QEP_2B*/
			"P8.12",	/*QEP_2A*/
			"P8.33",	/*QEP_1B*/
			"P8.35",	/*QEP_1A*/
			"P9.27",	/*QEP_0B*/
			"P9.42",	/*QEP_0A*/
			"P8.15",	/*PRU_ENCODER_B*/
			"P8.16",	/*PRU_ENCODER_A*/


			"eqep0",
			"eqep1",
			"eqep2",

	fragment@0 {
		target = <&am33xx_pinmux>;
		__overlay__ {
			pinctrl_eqep0: pinctrl_eqep0_pins {
				pinctrl-single,pins = <
					/* EQEP */
				0x1A0 0x31  /* P9_42,EQEP0A, MODE1 */       
				0x1A4 0x31  /* P9_27,EQEP0B, MODE1 */  
				0x0D4 0x32  /* P8_33,EQEP1B, MODE2 */
				0x0D0 0x32  /* P8_35,EQEP1A, MODE2 */
				0x030 0x34  /* P8_12,EQEP2A_in, MODE4 */
				0x034 0x34  /* P8_11,EQEP2B_in, MODE4 */

				/* PRU encoder input */
				0x03c 0x36	/* P8_15,PRU0_r31_15,MODE6 */ 
				0x038 0x36	/* P8_16,PRU0_r31_16,MODE6 */
				>;
			};
		};
	};

/****************************************
 		PWMSS			
****************************************/	
fragment@2 {
	target = <&epwmss0>;
	__overlay__ {
		status = "okay";
	};
};

fragment@3 {
	target = <&epwmss1>;
	__overlay__ {
		status = "okay";
	};
};

fragment@4 {
	target = <&epwmss2>;
	__overlay__ {
		status = "okay";
	};
};


fragment@8 {
	target = <&eqep0>;
	__overlay__ {
		count_mode = <0>;  /* 0 - Quadrature mode, normal 90 phase offset cha & chb.  1 - Direction mode.  cha input = clock, chb input = direction */
		swap_inputs = <0>; /* Are channel A and channel B swapped? (0 - no, 1 - yes) */
		invert_qa = <1>;   /* Should we invert the channel A input?  */
		invert_qb = <1>;   /* Should we invert the channel B input? I invert these because my encoder outputs drive transistors that pull down the pins */
		invert_qi = <0>;   /* Should we invert the index input? */
		invert_qs = <0>;   /* Should we invert the strobe input? */
		
		status = "okay";
	};
};

fragment@9 {
	target = <&eqep1>;
	__overlay__ {
		count_mode = <0>;  /* 0 - Quadrature mode, normal 90 phase offset cha & chb.  1 - Direction mode.  cha input = clock, chb input = direction */
		swap_inputs = <0>; /* Are channel A and channel B swapped? (0 - no, 1 - yes) */
		invert_qa = <1>;   /* Should we invert the channel A input?  */
		invert_qb = <1>;   /* Should we invert the channel B input? I invert these because my encoder outputs drive transistors that pull down the pins */
		invert_qi = <0>;   /* Should we invert the index input? */
		invert_qs = <0>;   /* Should we invert the strobe input? */
		status = "okay";
	};
};

fragment@10 {
	target = <&eqep2>;
	__overlay__ {
		count_mode = <0>;  /* 0 - Quadrature mode, normal 90 phase offset cha & chb.  1 - Direction mode.  cha input = clock, chb input = direction */
		swap_inputs = <0>; /* Are channel A and channel B swapped? (0 - no, 1 - yes) */
		invert_qa = <1>;   /* Should we invert the channel A input?  */
		invert_qb = <1>;   /* Should we invert the channel B input? I invert these because my encoder outputs drive transistors that pull down the pins */
		invert_qi = <0>;   /* Should we invert the index input? */
		invert_qs = <0>;   /* Should we invert the strobe input? */
		status = "okay";
	};
};

