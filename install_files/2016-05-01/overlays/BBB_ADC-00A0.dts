/*
 * Custom overlay for ADC for Beaglebone Blue
 * Author: Kiran Kumar Lekkala
 */

 
/dts-v1/;
/plugin/;

/ {
	compatible = "ti,beaglebone", "ti,beaglebone-black", "ti,beaglebone-green";

	// identification
	part-number = "BBB_ADC";
	version = "00A0";

	// resources this cape uses
	exclusive-use =
		"P9.37", 	/*AIN2*/
		"P9.38", 	/*AIN3*/
		"P9.39", 	/*AIN0*/
		"P9.40", 	/*AIN1*/

		"tscadc";	// hardware ip used


	fragment@0 {
		target = <&tscadc>;
		__overlay__ {

			status = "okay";
			adc {
    		ti,adc-channels = <0 1 2 3>;
			};
		};
	};
};
